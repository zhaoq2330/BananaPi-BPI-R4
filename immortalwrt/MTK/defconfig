## immortalwrt/MTK/defconfig
```kconfig
# chasey-dev 25.12-dev-wifi7 / BPI-R4

CONFIG_TARGET_mediatek=y
CONFIG_TARGET_mediatek_filogic=y
CONFIG_TARGET_mediatek_filogic_DEVICE_bananapi_bpi-r4=y
CONFIG_PACKAGE_kmod-mediatek_hnat=y
CONFIG_DEVEL=y
CONFIG_CCACHE=y
CONFIG_TOOLCHAINOPTS=y
# CONFIG_TARGET_ROOTFS_INITRAMFS is not set
CONFIG_TARGET_ROOTFS_PARTSIZE=8192
CONFIG_UNETD_VXLAN_SUPPORT=y
CONFIG_VPNC_GNUTLS=y
CONFIG_ZRAM_DEF_COMP_LZORLE=y
CONFIG_IPV6=y
CONFIG_DRIVER_11AC_SUPPORT=y
CONFIG_DRIVER_11AX_SUPPORT=y
CONFIG_DRIVER_11BE_SUPPORT=y

# nftables firewall
CONFIG_PACKAGE_firewall4=y
CONFIG_PACKAGE_odhcp6c=y
CONFIG_PACKAGE_odhcpd-ipv6only=y
CONFIG_PACKAGE_iptables-nft=y
CONFIG_PACKAGE_ip6tables-nft=y
CONFIG_PACKAGE_ppp=y
CONFIG_PACKAGE_ppp-mod-pppoe=y

# --- WiFi (upstream mac80211/mt76 mt7996e stack) ---
# Vendor mt_wifi7 driver removed until the upstream source builds again;
# use the upstream mt76/mt7996e path together with mtk_wed instead.
CONFIG_PACKAGE_kmod-cfg80211=y
CONFIG_PACKAGE_kmod-mac80211=y
CONFIG_PACKAGE_kmod-mtk_wed=y
CONFIG_PACKAGE_kmod-mt76-connac=y
CONFIG_PACKAGE_kmod-mt76-core=y
CONFIG_PACKAGE_kmod-mt7990-firmware=y
CONFIG_PACKAGE_kmod-mt7996-233-firmware=y
CONFIG_PACKAGE_kmod-mt7996-firmware=y
CONFIG_PACKAGE_kmod-mt7996-firmware-common=y
CONFIG_PACKAGE_kmod-mt7996e=y
CONFIG_PACKAGE_nand-utils=y

# --- HNAT ---
CONFIG_PACKAGE_kmod-mediatek_hnat=y
CONFIG_KERNEL_NET_MEDIATEK_HNAT=y
CONFIG_KERNEL_MEDIATEK_NETSYS_V3=y
# CONFIG_KERNEL_MEDIATEK_NETSYS_V2 is not set

# --- Platform tools ---
CONFIG_PACKAGE_mii_mgr=y
CONFIG_PACKAGE_regs=y
CONFIG_PACKAGE_switch=y
CONFIG_PACKAGE_pce=y
CONFIG_PACKAGE_mtkhnat_util=y
CONFIG_PACKAGE_ethswbox=y
CONFIG_PACKAGE_flowtable=y
CONFIG_PACKAGE_tops-tool=y

# 5G / WWAN / SFP bring-up and diagnostics.
# CONFIG_MODEMMANAGER_WITH_MBIM is not set
# CONFIG_MODEMMANAGER_WITH_QMI is not set
# CONFIG_MODEMMANAGER_WITH_QRTR is not set
CONFIG_PACKAGE_kmod-eeprom-at24=y
CONFIG_PACKAGE_aqr10g-phy-fw=y
CONFIG_PACKAGE_kmod-hwmon-pwmfan=y
CONFIG_PACKAGE_kmod-i2c-mux-pca954x=y
CONFIG_PACKAGE_kmod-phy-aquantia=y
CONFIG_PACKAGE_kmod-phy-marvell-10g=y
CONFIG_PACKAGE_kmod-phy-realtek=y
CONFIG_PACKAGE_kmod-rtc-pcf8563=y
# CONFIG_PACKAGE_kmod-sfp is not set
CONFIG_PACKAGE_kmod-usb3=y
# CONFIG_PACKAGE_kmod-usb-serial-option is not set
# CONFIG_PACKAGE_kmod-usb-serial-qualcomm is not set
CONFIG_PACKAGE_kmod-usb-acm=y
# CONFIG_PACKAGE_kmod-usb-wdm is not set
# CONFIG_PACKAGE_kmod-usb-net-cdc-mbim is not set
# CONFIG_PACKAGE_kmod-usb-net-qmi-wwan is not set
# CONFIG_PACKAGE_kmod-usb-net-qmi-wwan-fibocom is not set
# CONFIG_PACKAGE_kmod-pcie_mhi is not set
# CONFIG_PACKAGE_kmod-mhi-bus is not set
# CONFIG_PACKAGE_kmod-mhi-wwan-mbim is not set
# CONFIG_PACKAGE_kmod-wwan is not set
# CONFIG_PACKAGE_kmod-qrtr-mhi is not set
# CONFIG_PACKAGE_kmod-mtk-t7xx is not set
# CONFIG_PACKAGE_usbmode is not set
CONFIG_PACKAGE_ethtool-full=y
CONFIG_PACKAGE_pciids=y
CONFIG_PACKAGE_pciutils=y
CONFIG_PACKAGE_usbids=y
CONFIG_PACKAGE_usbutils=y
CONFIG_PACKAGE_tcpdump-mini=y
CONFIG_PACKAGE_iperf3=y
CONFIG_PACKAGE_blkid=y
CONFIG_PACKAGE_btrfs-progs=y
CONFIG_PACKAGE_dosfstools=y
CONFIG_PACKAGE_e2fsprogs=y
CONFIG_PACKAGE_exfat-fsck=y
CONFIG_PACKAGE_exfat-mkfs=y
CONFIG_PACKAGE_lsblk=y
CONFIG_PACKAGE_mount-utils=y
CONFIG_PACKAGE_kmod-fs-exfat=y
CONFIG_PACKAGE_kmod-fs-msdos=y
CONFIG_PACKAGE_kmod-fs-ntfs3=y
CONFIG_PACKAGE_kmod-nls-cp932=y
CONFIG_PACKAGE_kmod-nls-cp936=y
CONFIG_PACKAGE_kmod-nls-cp950=y
CONFIG_PACKAGE_kmod-nls-utf8=y
CONFIG_PACKAGE_parted=y
CONFIG_PACKAGE_smartmontools=y
CONFIG_PACKAGE_kmod-nvme=y

# Core service set trimmed to packages that are present in current feeds.
CONFIG_PACKAGE_adguardhome=y
CONFIG_PACKAGE_alsa-utils=y
# CONFIG_PACKAGE_aria2 is not set
# CONFIG_PACKAGE_ariang is not set
CONFIG_PACKAGE_bash=y
CONFIG_PACKAGE_autocore-arm=y
CONFIG_PACKAGE_block-mount=y
CONFIG_PACKAGE_ca-bundle=y
CONFIG_PACKAGE_ca-certificates=y
CONFIG_PACKAGE_cgroupfs-mount=y
# CONFIG_PACKAGE_cloudflared is not set
CONFIG_PACKAGE_containerd=y
CONFIG_PACKAGE_cpufreq=y
CONFIG_PACKAGE_curl=y
CONFIG_PACKAGE_ddns-scripts-services=y
# CONFIG_PACKAGE_ddnsto is not set
CONFIG_PACKAGE_dnsmasq-full=y
CONFIG_PACKAGE_docker=y
CONFIG_PACKAGE_docker-compose=y
CONFIG_PACKAGE_dockerd=y
# CONFIG_PACKAGE_fibocom-dial is not set
CONFIG_PACKAGE_frpc=y
# CONFIG_PACKAGE_geoview is not set
CONFIG_PACKAGE_htop=y
# CONFIG_PACKAGE_haproxy is not set
# CONFIG_PACKAGE_hysteria is not set
CONFIG_PACKAGE_ip-full=y
CONFIG_PACKAGE_ipset=y
CONFIG_PACKAGE_iputils-arping=y
CONFIG_PACKAGE_jq=y
CONFIG_PACKAGE_jsonfilter=y
CONFIG_PACKAGE_kmod-dummy=y
CONFIG_PACKAGE_kmod-inet-diag=y
CONFIG_PACKAGE_kmod-nft-socket=y
CONFIG_PACKAGE_kmod-nft-tproxy=y
CONFIG_PACKAGE_kmod-tun=y
CONFIG_PACKAGE_libiconv-full=y
CONFIG_PACKAGE_libncurses=y
CONFIG_PACKAGE_libopenssl=y
CONFIG_PACKAGE_libpthread=y
CONFIG_PACKAGE_libreadline=y
CONFIG_PACKAGE_librt=y
# CONFIG_PACKAGE_meig-cm is not set
# CONFIG_PACKAGE_mihomo is not set
CONFIG_PACKAGE_miniupnpd-nftables=y
# CONFIG_PACKAGE_modemband is not set
# CONFIG_PACKAGE_modemmanager is not set
CONFIG_PACKAGE_mosdns=y
CONFIG_PACKAGE_netdata=y
# CONFIG_PACKAGE_nikki is not set
CONFIG_PACKAGE_nlbwmon=y
CONFIG_PACKAGE_openssl-util=y
CONFIG_PACKAGE_p910nd=y
# CONFIG_PACKAGE_quectel-cm is not set
CONFIG_PACKAGE_rpcd-mod-ucode=y
CONFIG_PACKAGE_runc=y
# CONFIG_PACKAGE_ruby is not set
# CONFIG_PACKAGE_ruby-yaml is not set
# CONFIG_PACKAGE_shadowsocks-libev-config is not set
# CONFIG_PACKAGE_shadowsocks-libev-ss-local is not set
# CONFIG_PACKAGE_shadowsocks-libev-ss-redir is not set
# CONFIG_PACKAGE_shadowsocks-libev-ss-server is not set
# CONFIG_PACKAGE_shadowsocks-rust-sslocal is not set
# CONFIG_PACKAGE_shadowsocks-rust-ssserver is not set
CONFIG_PACKAGE_shairport-sync-openssl=y
# CONFIG_PACKAGE_shadow-tls is not set
# CONFIG_PACKAGE_simple-obfs-client is not set
# CONFIG_PACKAGE_sing-box is not set
# CONFIG_SING_BOX_BUILD_ACME is not set
# CONFIG_SING_BOX_BUILD_CLASH_API is not set
# CONFIG_SING_BOX_BUILD_ECH is not set
# CONFIG_SING_BOX_BUILD_GVISOR is not set
# CONFIG_SING_BOX_BUILD_QUIC is not set
# CONFIG_SING_BOX_BUILD_REALITY_SERVER is not set
# CONFIG_SING_BOX_BUILD_UTLS is not set
# CONFIG_SING_BOX_BUILD_WIREGUARD is not set
CONFIG_PACKAGE_smartdns=y
# CONFIG_PACKAGE_sms-tool is not set
CONFIG_PACKAGE_softethervpn5-bridge=y
CONFIG_PACKAGE_softethervpn5-client=y
CONFIG_PACKAGE_softethervpn5-server=y
CONFIG_PACKAGE_sqm-scripts=y
CONFIG_PACKAGE_tar=y
CONFIG_PACKAGE_tcping=y
CONFIG_PACKAGE_ttyd=y
# CONFIG_PACKAGE_tuic-client is not set
# CONFIG_PACKAGE_umbim is not set
CONFIG_PACKAGE_ucode-mod-digest=y
CONFIG_PACKAGE_ucode-mod-socket=y
CONFIG_PACKAGE_unzip=y
# CONFIG_PACKAGE_uqmi is not set
CONFIG_PACKAGE_v2dat=y
# CONFIG_PACKAGE_v2ray-geoip is not set
# CONFIG_PACKAGE_v2ray-geosite is not set
# CONFIG_PACKAGE_v2ray-plugin is not set
CONFIG_PACKAGE_vlmcsd=y
CONFIG_PACKAGE_wget-ssl=y
CONFIG_PACKAGE_wsdd2=y
CONFIG_PACKAGE_wireless-tools=y
CONFIG_PACKAGE_wrtbwmon=y
CONFIG_PACKAGE_xz-utils=y
# CONFIG_PACKAGE_xray-core is not set
# CONFIG_PACKAGE_xray-plugin is not set
CONFIG_PACKAGE_yq=y
CONFIG_PACKAGE_zlib=y

# LuCI core + stable apps.
CONFIG_LUCI_LANG_zh_Hans=y
CONFIG_PACKAGE_luci-compat=y
CONFIG_PACKAGE_luci-lib-chartjs=y
CONFIG_PACKAGE_luci-lib-docker=y
CONFIG_PACKAGE_luci-ssl-openssl=y
CONFIG_PACKAGE_luci-app-ddns=y
CONFIG_PACKAGE_luci-app-dockerman=y
CONFIG_PACKAGE_luci-app-filemanager=y
CONFIG_PACKAGE_luci-app-firewall=y
# CONFIG_PACKAGE_luci-app-modemband is not set
# CONFIG_PACKAGE_luci-app-mtwifi-cfg is not set
CONFIG_PACKAGE_luci-app-nlbwmon=y
CONFIG_PACKAGE_luci-app-samba4=y
CONFIG_PACKAGE_luci-app-sqm=y
CONFIG_PACKAGE_luci-app-ttyd=y
CONFIG_PACKAGE_luci-app-eqos-mtk=y
CONFIG_PACKAGE_luci-app-turboacc-mtk=y
CONFIG_PACKAGE_luci-app-upnp=y
CONFIG_PACKAGE_luci-app-wol=y
CONFIG_PACKAGE_luci-app-zerotier=y
CONFIG_PACKAGE_luci-i18n-base-zh-cn=y
# CONFIG_PACKAGE_luci-proto-3g is not set
# CONFIG_PACKAGE_luci-proto-mbim is not set
# CONFIG_PACKAGE_luci-proto-modemmanager is not set
# CONFIG_PACKAGE_luci-proto-qmi is not set
# CONFIG_PACKAGE_luci-proto-quectel is not set
CONFIG_PACKAGE_luci-proto-vpnc=y
CONFIG_PACKAGE_luci-proto-vxlan=y
CONFIG_PACKAGE_luci-proto-wireguard=y

# Community LuCI apps supplied by diy-part5.sh.
CONFIG_PACKAGE_luci-theme-argon=y
CONFIG_PACKAGE_luci-app-argon-config=y
CONFIG_PACKAGE_luci-app-adguardhome=y
CONFIG_PACKAGE_luci-app-fan=y
CONFIG_PACKAGE_luci-app-airplay2=y
# CONFIG_PACKAGE_luci-app-aria2 is not set
# CONFIG_PACKAGE_luci-app-cloudflared is not set
CONFIG_PACKAGE_luci-app-commands=y
CONFIG_PACKAGE_luci-app-cpufreq=y
# CONFIG_PACKAGE_luci-app-ddnsto is not set
# CONFIG_PACKAGE_luci-app-diskman is not set
# CONFIG_PACKAGE_luci-app-diskman_INCLUDE_btrfs_progs is not set
# CONFIG_PACKAGE_luci-app-diskman_INCLUDE_lsblk is not set
CONFIG_PACKAGE_luci-app-frpc=y
# CONFIG_PACKAGE_luci-app-homeproxy is not set
CONFIG_PACKAGE_luci-app-mosdns=y
CONFIG_PACKAGE_luci-app-netdata=y
# CONFIG_PACKAGE_luci-app-nikki is not set
# CONFIG_PACKAGE_luci-app-openclash is not set
# CONFIG_PACKAGE_luci-app-passwall is not set
# CONFIG_PACKAGE_luci-app-passwall_Iptables_Transparent_Proxy is not set
# CONFIG_PACKAGE_luci-app-passwall_Nftables_Transparent_Proxy is not set
# CONFIG_PACKAGE_luci-app-passwall_INCLUDE_Geoview is not set
# CONFIG_PACKAGE_luci-app-passwall_INCLUDE_Haproxy is not set
# CONFIG_PACKAGE_luci-app-passwall_INCLUDE_Hysteria is not set
# CONFIG_PACKAGE_luci-app-passwall_INCLUDE_NaiveProxy is not set
# CONFIG_PACKAGE_luci-app-passwall_INCLUDE_Shadowsocks_Libev_Client is not set
# CONFIG_PACKAGE_luci-app-passwall_INCLUDE_Shadowsocks_Libev_Server is not set
# CONFIG_PACKAGE_luci-app-passwall_INCLUDE_Shadowsocks_Rust_Client is not set
# CONFIG_PACKAGE_luci-app-passwall_INCLUDE_Shadowsocks_Rust_Server is not set
# CONFIG_PACKAGE_luci-app-passwall_INCLUDE_ShadowsocksR_Libev_Client is not set
# CONFIG_PACKAGE_luci-app-passwall_INCLUDE_ShadowsocksR_Libev_Server is not set
# CONFIG_PACKAGE_luci-app-passwall_INCLUDE_Shadow_TLS is not set
# CONFIG_PACKAGE_luci-app-passwall_INCLUDE_Simple_Obfs is not set
# CONFIG_PACKAGE_luci-app-passwall_INCLUDE_SingBox is not set
# CONFIG_PACKAGE_luci-app-passwall_INCLUDE_V2ray_Geodata is not set
# CONFIG_PACKAGE_luci-app-passwall_INCLUDE_V2ray_Plugin is not set
# CONFIG_PACKAGE_luci-app-passwall_INCLUDE_Xray is not set
# CONFIG_PACKAGE_luci-app-passwall_INCLUDE_Xray_Plugin is not set
CONFIG_PACKAGE_luci-app-ramfree=y
# CONFIG_PACKAGE_luci-app-sfp-status is not set
CONFIG_PACKAGE_luci-app-softethervpn=y
CONFIG_PACKAGE_luci-app-smartdns=y
# CONFIG_PACKAGE_luci-app-ssr-plus is not set
# CONFIG_PACKAGE_luci-app-ssr-plus_INCLUDE_Iptables_Transparent_Proxy is not set
# CONFIG_PACKAGE_luci-app-ssr-plus_INCLUDE_Nftables_Transparent_Proxy is not set
# CONFIG_PACKAGE_luci-app-ssr-plus_INCLUDE_NONE_V2RAY is not set
# CONFIG_PACKAGE_luci-app-ssr-plus_INCLUDE_Xray is not set
# CONFIG_PACKAGE_luci-app-ssr-plus_INCLUDE_ChinaDNS_NG is not set
# CONFIG_PACKAGE_luci-app-ssr-plus_INCLUDE_MosDNS is not set
# CONFIG_PACKAGE_luci-app-ssr-plus_INCLUDE_Hysteria is not set
# CONFIG_PACKAGE_luci-app-ssr-plus_INCLUDE_Tuic_Client is not set
# CONFIG_PACKAGE_luci-app-ssr-plus_INCLUDE_Mihomo is not set
# CONFIG_PACKAGE_luci-app-ssr-plus_INCLUDE_Shadow_TLS is not set
# CONFIG_PACKAGE_luci-app-ssr-plus_INCLUDE_Kcptun is not set
# CONFIG_PACKAGE_luci-app-ssr-plus_INCLUDE_NaiveProxy is not set
# CONFIG_PACKAGE_luci-app-ssr-plus_INCLUDE_Shadowsocks_NONE_Client is not set
# CONFIG_PACKAGE_luci-app-ssr-plus_INCLUDE_Shadowsocks_Rust_Client is not set
# CONFIG_PACKAGE_luci-app-ssr-plus_INCLUDE_Shadowsocks_NONE_Server is not set
# CONFIG_PACKAGE_luci-app-ssr-plus_INCLUDE_Shadowsocks_Rust_Server is not set
# CONFIG_PACKAGE_luci-app-ssr-plus_INCLUDE_Shadowsocks_Simple_Obfs is not set
# CONFIG_PACKAGE_luci-app-ssr-plus_INCLUDE_Shadowsocks_V2ray_Plugin is not set
# CONFIG_PACKAGE_luci-app-ssr-plus_INCLUDE_ShadowsocksR_Libev_Client is not set
# CONFIG_PACKAGE_luci-app-ssr-plus_INCLUDE_ShadowsocksR_Libev_Server is not set
CONFIG_PACKAGE_luci-app-socat=y
CONFIG_PACKAGE_luci-app-usb-printer=y
CONFIG_PACKAGE_luci-app-vlmcsd=y
CONFIG_PACKAGE_luci-app-wechatpush=y
CONFIG_PACKAGE_luci-app-wrtbwmon=y

# Keep the SSR Libev client pieces, but leave the server off on aarch64 defaults.
# CONFIG_PACKAGE_shadowsocksr-libev-ssr-local is not set
# CONFIG_PACKAGE_shadowsocksr-libev-ssr-redir is not set
# CONFIG_PACKAGE_shadowsocksr-libev-ssr-server is not set

# Samba4 / discovery options kept explicit for the LuCI app.
CONFIG_PACKAGE_samba4-libs=y
CONFIG_PACKAGE_samba4-server=y
CONFIG_SAMBA4_SERVER_AVAHI=y
CONFIG_SAMBA4_SERVER_NETBIOS=y
CONFIG_SAMBA4_SERVER_VFS=y
CONFIG_SAMBA4_SERVER_WSDD2=y
```
